// SPDX-License-Identifier: (GPL-2.0 OR MIT)

#include "mt7986a-bananapi-bpi-r3-mini.dts"

/ {
	model = "BananaPi BPi-R3 mini (eMMC)";
	compatible = "bananapi,bpi-r3-mini-emmc", "mediatek,mt7986a";
};
